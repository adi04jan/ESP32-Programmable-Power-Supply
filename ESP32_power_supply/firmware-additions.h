// =============================================================================
// firmware-additions.h
//
// Companion for the Voltbench webpage. Adds:
//   1. Preferences (NVS) for all settings + saved Wi-Fi credentials
//   2. gzip-compressed PROGMEM HTML served with Content-Encoding: gzip
//   3. AsyncWebSocket push of /status (drops idle polling)
//   4. Optional bearer-token auth (X-Auth header)
//   5. Captive-portal AP fallback when no SSID can connect
//   6. PubSubClient MQTT bridge
//
// Include this header AFTER the existing sketch globals (struct State, globals,
// setOutput, setVoltage, apply_command) are defined.
// =============================================================================
#pragma once

#include <Preferences.h>
#include <ArduinoJson.h>
#include <ESPAsyncWebServer.h>
#include <AsyncJson.h>
#include <DNSServer.h>
#include <WiFi.h>
#include <esp_system.h>
#include <esp_random.h>
#include <PubSubClient.h>
#include <WiFiClient.h>

// Gzip-compressed index page (generated by PowerShell, see web_page.h)
extern const uint8_t  index_html_gz[]     PROGMEM;
extern const size_t   index_html_gz_len;

// Forward declarations — defined in the main sketch
extern AsyncWebServer server;
extern struct State   psState;
extern volatile uint32_t g_measured_mV;
extern volatile uint32_t g_setpoint_mV;
extern void setOutput(uint8_t output, bool state);
extern void setVoltage(float voltage);
extern bool apply_command(const String &action, uint8_t ch, float val);
extern int  read_5V_volt();
extern int  read_3V3_volt();
extern volatile uint32_t g_5v_mV, g_3v3_mV;   // rails sampled by the control task

// Voltage-control state (defined in main sketch)
extern volatile uint8_t  g_vctrl_state;

// Output-1 calibration map + smoothed display (defined in main sketch)
extern uint16_t          g_cal_mv[128];
extern volatile bool     g_cal_valid;
extern volatile bool     g_cal_sweep_req;
extern volatile uint32_t g_display_mV;

// =============================================================================
//   WiFi manager — globals shared between manager task, scan task, HTTP handlers
// =============================================================================
static volatile int16_t  g_scan_result    = WIFI_SCAN_FAILED; // -2=idle,-1=running,>=0=count
static volatile bool     g_scan_busy      = false;
static volatile uint32_t g_scan_done_at   = 0;     // millis() at last scan completion (W5 cache)
static volatile bool     g_wifi_conn_busy = false; // true during any connection attempt
static SemaphoreHandle_t g_wifi_ready     = nullptr; // given when initial WiFi phase ends

// Forward declaration (defined in captive portal section below)
void vb_start_captive_ap();

// ---------- Scan task ----------
// Runs WiFi.scanNetworks() (blocking) on its own stack so it never executes on
// the lwIP / AsyncWebServer task.  CRITICAL: esp_wifi_connect() called during an
// active scan silently kills the scan and never fires WIFI_EVENT_SCAN_DONE —
// waitStatusBits then blocks for 60 s.  vb_trigger_scan() guards against this.
static void _wfScanTask(void*) {
  WiFi.scanDelete();
  int16_t n = WiFi.scanNetworks(false, true);  // blocking, include hidden SSIDs
  g_scan_result = (n < 0) ? WIFI_SCAN_FAILED : n;
  g_scan_done_at = millis();
  g_scan_busy   = false;
  vTaskDelete(NULL);
}

static void vb_trigger_scan() {
  if (g_scan_busy || g_wifi_conn_busy) return;
  g_scan_busy   = true;
  g_scan_result = WIFI_SCAN_RUNNING;
  xTaskCreate(_wfScanTask, "wfscan", 4096, nullptr, 1, nullptr);
}

// =============================================================================
//   Settings + persistent storage
// =============================================================================
struct VBSettings {
  String   mdns          = "voltbench";
  bool     require_login = true;
  String   password      = "admin";
  String   auth_token    = "";

  String   ota_url       = "https://updates.example.com/voltbench/";
  bool     ota_ssl       = true;
  bool     ota_auto      = true;

  bool     exp_current   = false;
  bool     exp_fast      = true;
  bool     exp_smooth    = false;
  bool     exp_dial      = false;

  bool     mqtt_en       = false;
  String   mqtt_host     = "";
  uint16_t mqtt_port     = 1883;
  String   mqtt_user     = "";
  String   mqtt_pass     = "";
  String   mqtt_topic    = "voltbench";

  static const uint8_t MAX_SSID = 4;
  String   ssid[MAX_SSID];
  String   pass[MAX_SSID];
} vb;

Preferences vbPrefs;

void vb_load() {
  vbPrefs.begin("voltbench", true);
  vb.mdns          = vbPrefs.getString ("mdns",          vb.mdns);
  vb.require_login = vbPrefs.getBool   ("req_login",     vb.require_login);
  vb.password      = vbPrefs.getString ("password",      vb.password);
  vb.ota_url       = vbPrefs.getString ("ota_url",       vb.ota_url);
  vb.ota_ssl       = vbPrefs.getBool   ("ota_ssl",       vb.ota_ssl);
  vb.ota_auto      = vbPrefs.getBool   ("ota_auto",      vb.ota_auto);
  vb.exp_current   = vbPrefs.getBool   ("e_current",     vb.exp_current);
  vb.exp_fast      = vbPrefs.getBool   ("e_fast",        vb.exp_fast);
  vb.exp_smooth    = vbPrefs.getBool   ("e_smooth",      vb.exp_smooth);
  vb.exp_dial      = vbPrefs.getBool   ("e_dial",        vb.exp_dial);
  vb.mqtt_en       = vbPrefs.getBool   ("mq_en",         vb.mqtt_en);
  vb.mqtt_host     = vbPrefs.getString ("mq_host",       vb.mqtt_host);
  vb.mqtt_port     = vbPrefs.getUShort ("mq_port",       vb.mqtt_port);
  vb.mqtt_user     = vbPrefs.getString ("mq_user",       vb.mqtt_user);
  vb.mqtt_pass     = vbPrefs.getString ("mq_pass",       vb.mqtt_pass);
  vb.mqtt_topic    = vbPrefs.getString ("mq_topic",      vb.mqtt_topic);
  for (uint8_t i = 0; i < VBSettings::MAX_SSID; i++) {
    vb.ssid[i] = vbPrefs.getString(("ssid" + String(i)).c_str(), "");
    vb.pass[i] = vbPrefs.getString(("pass" + String(i)).c_str(), "");
  }
  vbPrefs.end();
}

void vb_save() {
  vbPrefs.begin("voltbench", false);
  vbPrefs.putString ("mdns",      vb.mdns);
  vbPrefs.putBool   ("req_login", vb.require_login);
  vbPrefs.putString ("password",  vb.password);
  vbPrefs.putString ("ota_url",   vb.ota_url);
  vbPrefs.putBool   ("ota_ssl",   vb.ota_ssl);
  vbPrefs.putBool   ("ota_auto",  vb.ota_auto);
  vbPrefs.putBool   ("e_current", vb.exp_current);
  vbPrefs.putBool   ("e_fast",    vb.exp_fast);
  vbPrefs.putBool   ("e_smooth",  vb.exp_smooth);
  vbPrefs.putBool   ("e_dial",    vb.exp_dial);
  vbPrefs.putBool   ("mq_en",     vb.mqtt_en);
  vbPrefs.putString ("mq_host",   vb.mqtt_host);
  vbPrefs.putUShort ("mq_port",   vb.mqtt_port);
  vbPrefs.putString ("mq_user",   vb.mqtt_user);
  vbPrefs.putString ("mq_pass",   vb.mqtt_pass);
  vbPrefs.putString ("mq_topic",  vb.mqtt_topic);
  vbPrefs.end();
}

// Output-1 calibration map persistence (256-byte blob in NVS)
void cal_save() {
  vbPrefs.begin("voltbench", false);
  vbPrefs.putBytes("calmap", (const void*)g_cal_mv, sizeof(g_cal_mv));
  vbPrefs.putBool ("calok",  g_cal_valid);
  vbPrefs.end();
}
void cal_load() {
  vbPrefs.begin("voltbench", true);
  if (vbPrefs.getBool("calok", false)) {
    size_t n = vbPrefs.getBytes("calmap", (void*)g_cal_mv, sizeof(g_cal_mv));
    g_cal_valid = (n == sizeof(g_cal_mv));
  }
  vbPrefs.end();
}

void vb_save_wifi_slot(uint8_t i, const String &ssid, const String &pass) {
  if (i >= VBSettings::MAX_SSID) return;
  vb.ssid[i] = ssid; vb.pass[i] = pass;
  vbPrefs.begin("voltbench", false);
  vbPrefs.putString(("ssid" + String(i)).c_str(), ssid);
  vbPrefs.putString(("pass" + String(i)).c_str(), pass);
  vbPrefs.end();
}

bool vb_remember_wifi(const String &ssid, const String &pass) {
  for (uint8_t i = 0; i < VBSettings::MAX_SSID; i++)
    if (vb.ssid[i] == ssid) { vb_save_wifi_slot(i, ssid, pass); return true; }
  for (uint8_t i = 0; i < VBSettings::MAX_SSID; i++)
    if (vb.ssid[i].isEmpty()) { vb_save_wifi_slot(i, ssid, pass); return true; }
  vb_save_wifi_slot(0, ssid, pass);
  return true;
}

void vb_forget_wifi(const String &ssid) {
  for (uint8_t i = 0; i < VBSettings::MAX_SSID; i++)
    if (vb.ssid[i] == ssid) vb_save_wifi_slot(i, "", "");
}

void vb_factory_reset() {
  vbPrefs.begin("voltbench", false);
  vbPrefs.clear();
  vbPrefs.end();
}

// =============================================================================
//   Captive portal AP fallback
// =============================================================================
DNSServer vb_dns;
bool vb_in_captive = false;

// ---------- Connection helpers (must be called from a FreeRTOS task) ----------

// Try one SSID for up to timeoutMs; returns true on success.
static bool _trySSID(const char* ssid, const char* pass, uint32_t timeoutMs) {
  WiFi.begin(ssid, pass);
  uint32_t t0 = millis();
  while (WiFi.status() != WL_CONNECTED && millis() - t0 < timeoutMs)
    vTaskDelay(pdMS_TO_TICKS(100));
  if (WiFi.status() == WL_CONNECTED) return true;
  WiFi.disconnect(false, false);
  vTaskDelay(pdMS_TO_TICKS(200));  // let the stack reach idle before next attempt
  return false;
}

// Try every saved SSID in order; holds g_wifi_conn_busy for the full duration so
// the scan task won't start while a connection attempt is in progress.
static bool _tryAllSSIDs(uint32_t perSsidMs) {
  g_wifi_conn_busy = true;
  for (uint8_t i = 0; i < VBSettings::MAX_SSID; i++) {
    if (vb.ssid[i].isEmpty()) continue;
    if (_trySSID(vb.ssid[i].c_str(), vb.pass[i].c_str(), perSsidMs)) {
      g_wifi_conn_busy = false;
      return true;
    }
  }
  g_wifi_conn_busy = false;
  return false;
}

void vb_start_captive_ap() {
  WiFi.mode(WIFI_AP_STA);   // STA interface required for scanNetworks() in AP mode
  String apName = "Voltbench-" + String((uint32_t)ESP.getEfuseMac(), HEX);
  WiFi.softAP(apName.c_str());
  vb_dns.start(53, "*", WiFi.softAPIP());
  vb_in_captive = true;
  Serial.printf("Captive AP: %s @ %s\n", apName.c_str(), WiFi.softAPIP().toString().c_str());
  // Scan is triggered by wifiMgrTask after an 800 ms settle delay, not here
}

// =============================================================================
//   Auth helpers
// =============================================================================
String vb_make_token() {
  String t = "";
  for (int i = 0; i < 4; i++) t += String(esp_random(), HEX);
  return t;
}

bool vb_authed(AsyncWebServerRequest *req) {
  if (!vb.require_login) return true;
  if (req->hasHeader("X-Auth"))
    return req->getHeader("X-Auth")->value() == vb.auth_token;
  return false;
}
#define VB_REQUIRE_AUTH(req) do { if (!vb_authed(req)) { req->send(401, "application/json", "{\"err\":\"auth\"}"); return; } } while (0)

// =============================================================================
//   WebSocket + telemetry broadcast
// =============================================================================
AsyncWebSocket vb_ws("/ws");
AsyncWebSocket logws("/logws");   // browser debug-log stream (view-only)

void vb_fill_status(JsonDocument &d) {
  d["output1"]  = psState.output1;
  d["output2"]  = psState.output2;
  d["output3"]  = psState.output3;
  d["voltage1"] = g_display_mV / 1000.0f;   // median-of-5 (spec §2.3)
  d["cal"]      = g_cal_valid;
  d["voltage2"] = g_5v_mV  / 1000.0f;
  d["voltage3"] = g_3v3_mV / 1000.0f;
  d["set1"]     = g_setpoint_mV / 1000.0f;
  d["ts"]       = (uint64_t)millis();
  static const char* const STATE_STR[] = {"idle","settling","verifying","frozen","busy"};
  d["state"] = STATE_STR[min((uint8_t)4, (uint8_t)g_vctrl_state)];
}

uint32_t vb_last_push = 0;
void vb_push_status() {
  if (vb_ws.count() == 0) return;
  if (millis() - vb_last_push < (vb.exp_fast ? 250 : 1000)) return;
  vb_last_push = millis();
  JsonDocument d;
  vb_fill_status(d);
  String out; serializeJson(d, out);
  vb_ws.textAll(out);
}

void vb_on_ws_event(AsyncWebSocket *srv, AsyncWebSocketClient *c,
                    AwsEventType t, void *arg, uint8_t *data, size_t len) {
  if (t != WS_EVT_DATA) return;
  AwsFrameInfo *fi = (AwsFrameInfo *)arg;
  if (!fi->final || fi->index != 0 || fi->len != len || fi->opcode != WS_TEXT) return;

  JsonDocument doc;
  if (deserializeJson(doc, data, len) != DeserializationError::Ok) return;

  if (vb.require_login) {
    const char *tok = doc["token"];
    if (!tok || String(tok) != vb.auth_token) { c->text("{\"err\":\"auth\"}"); return; }
  }

  const char *action = doc["action"];
  if (!action) return;
  String act = action;
  int    output = doc["output"] | 0;
  float  value  = doc["value"]  | 0.0f;

  float tval = value;
  if (act == "toggle")
    tval = doc["value"].is<bool>() ? (doc["value"].as<bool>() ? 1.0f : 0.0f) : value;
  apply_command(act, (uint8_t)output, tval);

  JsonDocument resp;
  vb_fill_status(resp);
  String out; serializeJson(resp, out);
  c->text(out);
}

// =============================================================================
//   MQTT bridge
// =============================================================================
WiFiClient   vb_mqtt_net;
PubSubClient vb_mqtt(vb_mqtt_net);
uint32_t     vb_last_mqtt = 0;

void vb_mqtt_cmd(char *topic, byte *payload, unsigned int len) {
  String t = topic;
  String p; p.reserve(len);
  for (unsigned i = 0; i < len; i++) p += (char)payload[i];
  String base = vb.mqtt_topic + "/cmd/";
  if (!t.startsWith(base)) return;
  String tail = t.substring(base.length());
  int slash = tail.indexOf('/');
  if (slash < 0) return;
  uint8_t ch = (uint8_t)tail.substring(2, slash).toInt();
  String  fn = tail.substring(slash + 1);
  if (fn == "output")       apply_command("toggle", ch, (p == "on" || p == "1") ? 1.0f : 0.0f);
  else if (fn == "voltage") apply_command("set_voltage", ch, p.toFloat());
}

void vb_mqtt_setup() {
  if (!vb.mqtt_en || vb.mqtt_host.isEmpty()) return;
  vb_mqtt.setServer(vb.mqtt_host.c_str(), vb.mqtt_port);
  vb_mqtt.setCallback(vb_mqtt_cmd);
}

void vb_mqtt_loop() {
  if (!vb.mqtt_en || vb.mqtt_host.isEmpty() || vb_in_captive) return;
  if (!vb_mqtt.connected()) {
    if (millis() - vb_last_mqtt < 5000) return;
    vb_last_mqtt = millis();
    String cid = "voltbench-" + String((uint32_t)ESP.getEfuseMac(), HEX);
    bool ok = vb.mqtt_user.isEmpty()
      ? vb_mqtt.connect(cid.c_str())
      : vb_mqtt.connect(cid.c_str(), vb.mqtt_user.c_str(), vb.mqtt_pass.c_str());
    if (ok) {
      vb_mqtt.subscribe((vb.mqtt_topic + "/cmd/#").c_str());
      vb_mqtt.publish ((vb.mqtt_topic + "/status").c_str(), "online", true);
    }
    return;
  }
  vb_mqtt.loop();
  static uint32_t last = 0;
  if (millis() - last > 1000) {
    last = millis();
    JsonDocument d; vb_fill_status(d);
    String out; serializeJson(d, out);
    vb_mqtt.publish((vb.mqtt_topic + "/tele").c_str(), out.c_str());
  }
}

// =============================================================================
//   HTTP routes (/api/* — replaces old /, /control, /status)
// =============================================================================
void vb_register_routes() {

  // Gzipped index
  server.on("/", HTTP_GET, [](AsyncWebServerRequest *req) {
    AsyncWebServerResponse *res =
      req->beginResponse_P(200, "text/html", index_html_gz, index_html_gz_len);
    res->addHeader("Content-Encoding", "gzip");
    res->addHeader("Cache-Control", "public, max-age=300");
    req->send(res);
  });

  server.onNotFound([](AsyncWebServerRequest *req) {
    if (vb_in_captive) { req->redirect("/"); return; }
    req->send(404, "text/plain", "Not found");
  });

  // Status — live telemetry, must never be cached (browsers heuristically cache
  // GETs with no Cache-Control, which froze the displayed voltage).
  server.on("/api/status", HTTP_GET, [](AsyncWebServerRequest *req) {
    VB_REQUIRE_AUTH(req);
    JsonDocument d; vb_fill_status(d);
    String out; serializeJson(d, out);
    AsyncWebServerResponse *res = req->beginResponse(200, "application/json", out);
    res->addHeader("Cache-Control", "no-store");
    req->send(res);
    return;
  });

  // Info
  server.on("/api/info", HTTP_GET, [](AsyncWebServerRequest *req) {
    JsonDocument d;
    d["fw"]            = CURRENT_FIRMWARE_VERSION;
    d["mdns"]          = vb.mdns;
    d["ip"]            = WiFi.localIP().toString();
    d["mac"]           = WiFi.macAddress();
    d["ssid"]          = WiFi.SSID();
    d["rssi"]          = WiFi.RSSI();
    d["uptime"]        = millis() / 1000;
    d["require_login"] = vb.require_login;
    d["captive"]       = vb_in_captive;
    auto ota = d["ota"].to<JsonObject>();
      ota["url"] = vb.ota_url; ota["ssl"] = vb.ota_ssl; ota["auto"] = vb.ota_auto;
    auto exp = d["exp"].to<JsonObject>();
      exp["current"] = vb.exp_current; exp["fast"] = vb.exp_fast;
      exp["smooth"]  = vb.exp_smooth;  exp["dial"]  = vb.exp_dial;
    auto m = d["mqtt"].to<JsonObject>();
      m["enabled"] = vb.mqtt_en; m["host"] = vb.mqtt_host;
      m["port"]    = vb.mqtt_port; m["user"] = vb.mqtt_user;
      m["topic"]   = vb.mqtt_topic;
    auto saved = d["saved_ssids"].to<JsonArray>();
    for (uint8_t i = 0; i < VBSettings::MAX_SSID; i++)
      if (!vb.ssid[i].isEmpty()) saved.add(vb.ssid[i]);
    String out; serializeJson(d, out);
    req->send(200, "application/json", out);
  });

  // Login
  server.on("/api/login", HTTP_POST, [](AsyncWebServerRequest *req) {
    String pass = req->hasParam("pass", true) ? req->getParam("pass", true)->value() : "";
    if (!vb.require_login || pass == vb.password) {
      vb.auth_token = vb_make_token();
      vb_save();
      JsonDocument d; d["ok"] = true; d["token"] = vb.auth_token;
      String out; serializeJson(d, out);
      req->send(200, "application/json", out);
    } else {
      req->send(200, "application/json", "{\"ok\":false,\"err\":\"bad-pass\"}");
    }
  });

  // Control
  server.on("/api/control", HTTP_POST, [](AsyncWebServerRequest *req) {
    VB_REQUIRE_AUTH(req);
    String  action = req->hasParam("action", true) ? req->getParam("action", true)->value() : "";
    uint8_t out    = req->hasParam("output", true) ? req->getParam("output", true)->value().toInt() : 0;
    float   val    = req->hasParam("value",  true) ? req->getParam("value",  true)->value().toFloat() : 0;
    apply_command(action, out, action == "toggle" ? (val == 1.0f ? 1.0f : 0.0f) : val);
    req->send(200, "application/json", "{\"ok\":true}");
  });

  // Settings (JSON body)
  AsyncCallbackJsonWebHandler *settingsHandler =
    new AsyncCallbackJsonWebHandler("/api/settings",
      [](AsyncWebServerRequest *req, JsonVariant &json) {
        if (!vb_authed(req)) { req->send(401); return; }
        JsonObject s = json.as<JsonObject>();
        if (s["mdns"].is<const char*>())     vb.mdns          = s["mdns"].as<String>();
        if (s["require_login"].is<bool>())   vb.require_login = s["require_login"];
        if (s["password"].is<const char*>()) vb.password      = s["password"].as<String>();
        if (s["ota"].is<JsonObject>()) {
          JsonObject o = s["ota"];
          if (o["url"].is<const char*>()) vb.ota_url  = o["url"].as<String>();
          if (o["ssl"].is<bool>())        vb.ota_ssl  = o["ssl"];
          if (o["auto"].is<bool>())       vb.ota_auto = o["auto"];
        }
        if (s["exp"].is<JsonObject>()) {
          JsonObject e = s["exp"];
          if (e["current"].is<bool>()) vb.exp_current = e["current"];
          if (e["fast"]   .is<bool>()) vb.exp_fast    = e["fast"];
          if (e["smooth"] .is<bool>()) vb.exp_smooth  = e["smooth"];
          if (e["dial"]   .is<bool>()) vb.exp_dial    = e["dial"];
        }
        if (s["mqtt"].is<JsonObject>()) {
          JsonObject m = s["mqtt"];
          if (m["enabled"].is<bool>())     vb.mqtt_en   = m["enabled"];
          if (m["host"].is<const char*>()) vb.mqtt_host = m["host"].as<String>();
          if (m["port"].is<int>())         vb.mqtt_port = m["port"];
          if (m["user"].is<const char*>()) vb.mqtt_user = m["user"].as<String>();
          if (m["pass"].is<const char*>()) vb.mqtt_pass = m["pass"].as<String>();
          if (m["topic"].is<const char*>())vb.mqtt_topic= m["topic"].as<String>();
          vb_mqtt_setup();
        }
        vb_save();
        req->send(200, "application/json", "{\"ok\":true}");
      });
  server.addHandler(settingsHandler);

  // Output-1 calibration: build the step->mV map by sweeping the wiper.
  // WARNING: drives output 1 across its full range — run with output 1 unloaded.
  server.on("/api/cal/sweep", HTTP_POST, [](AsyncWebServerRequest *req) {
    VB_REQUIRE_AUTH(req);
    if (g_vctrl_state == 4) { req->send(409, "application/json", "{\"err\":\"busy\"}"); return; }
    g_cal_sweep_req = true;
    req->send(200, "application/json", "{\"ok\":true,\"msg\":\"calibration sweep started\"}");
  });
  server.on("/api/cal/status", HTTP_GET, [](AsyncWebServerRequest *req) {
    JsonDocument d;
    d["valid"]   = g_cal_valid;
    d["running"] = (g_vctrl_state == 4);
    auto a = d["mv"].to<JsonArray>();
    for (int i = 0; i < 128; i++) a.add(g_cal_mv[i]);
    String out; serializeJson(d, out);
    req->send(200, "application/json", out);
  });
  server.on("/api/cal/clear", HTTP_POST, [](AsyncWebServerRequest *req) {
    VB_REQUIRE_AUTH(req);
    for (int i = 0; i < 128; i++) g_cal_mv[i] = 0;
    g_cal_valid = false;
    cal_save();
    req->send(200, "application/json", "{\"ok\":true}");
  });

  // Wi-Fi scan — results come from a dedicated FreeRTOS task (blocking scan).
  // Never start a scan while a WiFi connection attempt is in progress; calling
  // esp_wifi_connect() during a scan kills it silently (no SCAN_DONE event).
  server.on("/api/wifi/scan", HTTP_GET, [](AsyncWebServerRequest *req) {
    VB_REQUIRE_AUTH(req);
    if (g_wifi_conn_busy || g_scan_result == WIFI_SCAN_RUNNING) {
      req->send(202, "application/json", "{\"scanning\":true}"); return;
    }
    if (g_scan_result == WIFI_SCAN_FAILED || millis() - g_scan_done_at > 20000) {
      vb_trigger_scan();
      req->send(202, "application/json", "{\"scanning\":true}"); return;
    }
    JsonDocument d;
    auto arr = d["networks"].to<JsonArray>();
    for (int16_t i = 0; i < g_scan_result; i++) {
      if (WiFi.SSID(i).isEmpty()) continue;          // W6: skip hidden networks
      auto o = arr.add<JsonObject>();
      o["ssid"] = WiFi.SSID(i);
      o["rssi"] = WiFi.RSSI(i);
      o["sec"]  = WiFi.encryptionType(i) == WIFI_AUTH_OPEN ? "open" : "secured";
    }
    String out; serializeJson(d, out);
    req->send(200, "application/json", out);
    // W5: results stay cached for 20 s — no consume-and-invalidate.
  });

  // Wi-Fi connect — one attempt at a time; creds saved only after success.
  server.on("/api/wifi/connect", HTTP_POST, [](AsyncWebServerRequest *req) {
    VB_REQUIRE_AUTH(req);
    String ssid = req->hasParam("ssid", true) ? req->getParam("ssid", true)->value() : "";
    String pass = req->hasParam("pass", true) ? req->getParam("pass", true)->value() : "";
    if (ssid.isEmpty())    { req->send(400, "application/json", "{\"err\":\"ssid\"}"); return; }
    if (g_wifi_conn_busy)  { req->send(409, "application/json", "{\"err\":\"busy\"}"); return; }
    g_wifi_conn_busy = true;
    struct Req { String ssid, pass; };
    auto *r = new Req{ssid, pass};
    BaseType_t ok = xTaskCreate([](void *pv) {
      Req *r = (Req *)pv;
      vTaskDelay(pdMS_TO_TICKS(500));            // let the HTTP response flush
      WiFi.setAutoReconnect(false);
      WiFi.disconnect(false, false);
      vTaskDelay(pdMS_TO_TICKS(300));
      WiFi.begin(r->ssid.c_str(), r->pass.c_str());
      uint32_t t0 = millis();
      while (WiFi.status() != WL_CONNECTED && millis() - t0 < 15000)
        vTaskDelay(pdMS_TO_TICKS(100));
      if (WiFi.status() == WL_CONNECTED) {
        vb_remember_wifi(r->ssid, r->pass);      // W4: save only creds that worked
        WiFi.setAutoReconnect(true);
        g_wifi_conn_busy = false;
      } else {
        Dbg.printf("[WiFi] join '%s' failed — recovering\n", r->ssid.c_str());
        g_wifi_conn_busy = false;                // release before _tryAllSSIDs re-claims
        if (_tryAllSSIDs(5000)) WiFi.setAutoReconnect(true);
        else if (!vb_in_captive) vb_start_captive_ap();   // W1: never orphaned
      }
      delete r;
      vTaskDelete(NULL);
    }, "wifiSwitch", 4096, r, 1, NULL);
    if (ok != pdPASS) {
      delete r;
      g_wifi_conn_busy = false;
      req->send(500, "application/json", "{\"err\":\"task\"}");
      return;
    }
    req->send(200, "application/json", "{\"ok\":true}");
  });

  // Wi-Fi forget
  server.on("/api/wifi/forget", HTTP_POST, [](AsyncWebServerRequest *req) {
    VB_REQUIRE_AUTH(req);
    if (!req->hasParam("ssid", true)) { req->send(400); return; }
    vb_forget_wifi(req->getParam("ssid", true)->value());
    req->send(200, "application/json", "{\"ok\":true}");
  });

  // OTA
  server.on("/api/ota/check", HTTP_GET, [](AsyncWebServerRequest *req) {
    VB_REQUIRE_AUTH(req);
    req->send(200, "application/json",
      "{\"current\":\"" CURRENT_FIRMWARE_VERSION "\",\"latest\":\"unknown\",\"newer\":false}");
  });
  server.on("/api/ota/update", HTTP_POST, [](AsyncWebServerRequest *req) {
    VB_REQUIRE_AUTH(req);
    req->send(200, "application/json", "{\"ok\":true,\"msg\":\"checking GitHub\"}");
    extern void perform_ota_tasked(bool);
    perform_ota_tasked(false);            // only update if version.txt is newer
  });
  server.on("/api/ota/force", HTTP_POST, [](AsyncWebServerRequest *req) {
    VB_REQUIRE_AUTH(req);
    req->send(200, "application/json", "{\"ok\":true,\"msg\":\"forcing re-flash from GitHub\"}");
    extern void perform_ota_tasked(bool);
    perform_ota_tasked(true);             // re-download even if same version
  });

  // MQTT test
  server.on("/api/mqtt/test", HTTP_GET, [](AsyncWebServerRequest *req) {
    VB_REQUIRE_AUTH(req);
    if (vb.mqtt_host.isEmpty()) {
      req->send(200, "application/json", "{\"ok\":false,\"err\":\"no broker host configured\"}");
      return;
    }
    WiFiClient c;
    bool ok = c.connect(vb.mqtt_host.c_str(), vb.mqtt_port);
    c.stop();
    req->send(200, "application/json", ok ? "{\"ok\":true}" : "{\"ok\":false,\"err\":\"connect failed\"}");
  });

  // Reboot
  server.on("/api/reboot", HTTP_GET, [](AsyncWebServerRequest *req) {
    VB_REQUIRE_AUTH(req);
    req->send(200, "application/json", "{\"ok\":true}");
    delay(200);
    ESP.restart();
  });

  // Factory reset
  server.on("/api/factory_reset", HTTP_POST, [](AsyncWebServerRequest *req) {
    VB_REQUIRE_AUTH(req);
    vb_factory_reset();
    req->send(200, "application/json", "{\"ok\":true}");
    delay(200);
    ESP.restart();
  });

  // Web-upload OTA — POST the compiled .bin (multipart, field name doesn't matter):
  //   curl -H "X-Auth: <token>" -F "f=@ESP32_power_supply.ino.bin" http://<ip>/api/ota/upload
  // Writes the inactive OTA slot via Update.h and reboots on success. No USB needed.
  server.on("/api/ota/upload", HTTP_POST,
    [](AsyncWebServerRequest *req) {
      if (!vb_authed(req)) { req->send(401, "application/json", "{\"err\":\"auth\"}"); return; }
      bool ok = Update.isFinished() && !Update.hasError();
      AsyncWebServerResponse *res = req->beginResponse(ok ? 200 : 500, "application/json",
        ok ? "{\"ok\":true,\"msg\":\"flashed, rebooting\"}" : "{\"ok\":false,\"err\":\"update failed\"}");
      res->addHeader("Connection", "close");
      req->send(res);
      if (ok) { delay(300); ESP.restart(); }
    },
    [](AsyncWebServerRequest *req, String fn, size_t index, uint8_t *data, size_t len, bool final) {
      if (!vb_authed(req)) return;                       // ignore unauthenticated uploads
      if (index == 0) {
        Dbg.printf("[OTA] web upload start: %s\n", fn.c_str());
        if (!Update.begin(UPDATE_SIZE_UNKNOWN)) Update.printError(Dbg);
      }
      if (Update.isRunning() && Update.write(data, len) != len) Update.printError(Dbg);
      if (final && Update.isRunning()) {
        if (Update.end(true)) Dbg.printf("[OTA] web upload ok: %u bytes\n", (unsigned)(index + len));
        else Update.printError(Dbg);
      }
    });

  // WebSocket(s)
  vb_ws.onEvent(vb_on_ws_event);
  server.addHandler(&vb_ws);
  logws.onEvent([](AsyncWebSocket*, AsyncWebSocketClient*, AwsEventType, void*, uint8_t*, size_t){});
  server.addHandler(&logws);
}

// =============================================================================
//   Setup / loop helpers called from the main sketch
// =============================================================================
void vb_on_wifi_event(WiFiEvent_t event) {
  if (event == ARDUINO_EVENT_WIFI_STA_GOT_IP) {
    if (vb_in_captive) {
      vb_dns.stop();
      WiFi.softAPdisconnect(true);
      WiFi.mode(WIFI_STA);
      vb_in_captive = false;
      MDNS.begin(vb.mdns.c_str());
      Serial.printf("Joined %s — captive AP down. IP=%s\n",
                    WiFi.SSID().c_str(), WiFi.localIP().toString().c_str());
    } else {
      Serial.printf("WiFi reconnected: %s @ %s\n",
                    WiFi.SSID().c_str(), WiFi.localIP().toString().c_str());
    }
  }
}

// ---------- WiFi manager task ----------
// Owns the entire connection lifecycle so loop() never blocks on WiFi calls.
// Priority 2 (same as voltageControlTask) — time-shares core 0 via vTaskDelay yields.
static void wifiMgrTask(void*) {
  WiFi.setAutoReconnect(false);   // we drive all reconnection ourselves
  WiFi.mode(WIFI_STA);

  // Boot: try every saved SSID with a 5 s timeout (was 12 s; reduces AP-start delay)
  bool ok = _tryAllSSIDs(5000);

  if (ok) {
    WiFi.setAutoReconnect(true);
    MDNS.begin(vb.mdns.c_str());
    Serial.printf("WiFi OK: %s @ %s\n",
                  WiFi.SSID().c_str(), WiFi.localIP().toString().c_str());
  } else {
    vb_start_captive_ap();
    // Wait 800 ms for the AP radio to settle before starting the first scan.
    // Calling esp_wifi_scan_start() immediately after softAP() can return
    // ESP_ERR_WIFI_STATE and leave the scan permanently stuck.
    vTaskDelay(pdMS_TO_TICKS(800));
    vb_trigger_scan();
  }

  // Signal vb_setup() — it has been blocking on this semaphore
  xSemaphoreGive(g_wifi_ready);

  // Background loop: periodically retry saved SSIDs while in captive portal mode.
  // NEVER runs concurrently with g_scan_busy; doing so would call esp_wifi_connect()
  // mid-scan which silently kills the scan (no WIFI_EVENT_SCAN_DONE ever fires).
  for (;;) {
    vTaskDelay(pdMS_TO_TICKS(60000));   // retry interval
    if (!vb_in_captive) continue;
    if (g_wifi_conn_busy) continue;     // a user-initiated connect owns the radio

    // Politely wait for any in-progress scan to finish before connecting
    while (g_scan_busy) vTaskDelay(pdMS_TO_TICKS(300));
    if (!vb_in_captive) continue;       // re-check: scan may have triggered connect

    WiFi.setAutoReconnect(false);
    bool reconnected = _tryAllSSIDs(5000);
    if (reconnected) WiFi.setAutoReconnect(true);
    // vb_on_wifi_event handles AP teardown when GOT_IP fires after reconnect
  }
}

void vb_setup() {
  vb_load();
  if (vb.auth_token.isEmpty()) { vb.auth_token = vb_make_token(); vb_save(); }
  WiFi.onEvent(vb_on_wifi_event);

  g_wifi_ready = xSemaphoreCreateBinary();
  // Stack 8 KB — WiFi.begin() and the IDF scan stack are deeper than they look
  xTaskCreate(wifiMgrTask, "wifiMgr", 8192, nullptr, 2, nullptr);

  // Block until wifiMgrTask finishes its initial phase (max ~25 s: 4 SSIDs × 5 s + margin)
  xSemaphoreTake(g_wifi_ready, pdMS_TO_TICKS(30000));

  vb_register_routes();
  vb_mqtt_setup();
}

void vb_loop() {
  if (vb_in_captive) vb_dns.processNextRequest();
  // WiFi connection management is handled entirely by wifiMgrTask — nothing here.
  vb_push_status();
  vb_mqtt_loop();
  vb_ws.cleanupClients();
}
